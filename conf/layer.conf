## conf/layer.conf
```bitbake
# We have a conf and classes directory, add to BBPATH
BBPATH .= ":${LAYERDIR}"

# We have recipes-* directories, add to BBFILES
BBFILES += "${LAYERDIR}/recipes-*/*/*.bb \
	${LAYERDIR}/recipes-*/*/*.bbappend"

BBFILE_COLLECTIONS += "pmtr"
BBFILE_PATTERN_pmtr = "^${LAYERDIR}/"
BBFILE_PRIORITY_pmtr = "6"
LAYERSERIES_COMPAT_pmtr = "dunfell"
```
